#include "cyboard.dtsi"

kscan0: kscan {
    compatible = "zmk,kscan-gpio-matrix";
    label = "KSCAN";
    wakeup-source;

    diode-direction = "row2col";
    col-gpios
        = <&pro_micro 9 (GPIO_ACTIVE_HIGH | GPIO_PULL_DOWN)> // col0 from schematic
        , <&pro_micro 18 (GPIO_ACTIVE_HIGH | GPIO_PULL_DOWN)> // col1 from schematic
        , <&pro_micro 15 (GPIO_ACTIVE_HIGH | GPIO_PULL_DOWN)> // col2 from schematic
        , <&pro_micro 14 (GPIO_ACTIVE_HIGH | GPIO_PULL_DOWN)> // col3 from schematic
        , <&pro_micro 21 (GPIO_ACTIVE_HIGH | GPIO_PULL_DOWN)> // col4 from schematic
        , <&pro_micro 4 (GPIO_ACTIVE_HIGH | GPIO_PULL_DOWN)> // col5 from schematic
        , <&pro_micro 5 (GPIO_ACTIVE_HIGH | GPIO_PULL_DOWN)> // col6 from schematic
        , <&pro_micro 3 (GPIO_ACTIVE_HIGH | GPIO_PULL_DOWN)> // col6 from schematic
        ;
    row-gpios
        = <&pro_micro 8 GPIO_ACTIVE_HIGH> // row0 from schematic
        , <&pro_micro 7 GPIO_ACTIVE_HIGH> // row1 from schematic
        , <&pro_micro 20 GPIO_ACTIVE_HIGH> // row2 from schematic
        , <&pro_micro 6 GPIO_ACTIVE_HIGH> // row3 from schematic
        , <&pro_micro 16 GPIO_ACTIVE_HIGH> // row4 from schematic
        , <&pro_micro 19 GPIO_ACTIVE_HIGH> // row5 from schematic
        , <&pro_micro 10 GPIO_ACTIVE_HIGH> // row6 from schematic
        ;

};
