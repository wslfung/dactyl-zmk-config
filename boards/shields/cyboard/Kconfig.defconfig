## boards/shields/cyboard/Kconfig.defconfig
```kconfig
if SHIELD_CYBOARD_DONGLE

config ZMK_KEYBOARD_NAME
    default "Cyboard"

config ZMK_SPLIT_ROLE_CENTRAL
    default y

if ZMK_DISPLAY

config I2C
    default y

config SH1106
    default y

config LVGL
    default y

choice ZMK_DISPLAY_WORK_QUEUE
    default ZMK_DISPLAY_WORK_QUEUE_DEDICATED
endchoice

endif

if SH1106

config LV_Z_VDB_SIZE
    default 64

config LV_DPI_DEF
    default 148

config LV_Z_BITS_PER_PIXEL
    default 1

choice LV_COLOR_DEPTH
    default LV_COLOR_DEPTH_1
endchoice

endif

endif



if SHIELD_CYBOARD_DONGLE || SHIELD_CYBOARD_LEFT || SHIELD_CYBOARD_RIGHT

config ZMK_SPLIT
    default y

endif
```

## boards/shields/cyboard/Kconfig.shield
```kconfig
config SHIELD_CYBOARD_DONGLE
    def_bool $(shields_list_contains,cyboard_dongle)

config SHIELD_CYBOARD_LEFT
    def_bool $(shields_list_contains,cyboard_left)

config SHIELD_CYBOARD_RIGHT
    def_bool $(shields_list_contains,cyboard_right)
```

## config/west.yml
```yaml
manifest:
  remotes:
    - name: zmkfirmware
      url-base: https://github.com/zmkfirmware
    # Additional modules containing boards/shields/custom code can be listed here as well
    # See https://docs.zephyrproject.org/3.2.0/develop/west/manifest.html#projects
    - name: tokyo2006
      url-base: https://github.com/tokyo2006
    - name: englmaxi
      url-base: https://github.com/englmaxi    
  projects:
    - name: zmk
      remote: zmkfirmware
      revision: main
      import: app/west.yml
    - name: prospector-zmk-module                 # <--- and these
      remote: tokyo2006                          # <---
      revision: micro_spi2  
    - name: zmk-dongle-display
      remote: englmaxi
      revision: main
  self:
    path: config
```
